## arch/s390/um/Kconfig
```kconfig
# SPDX-License-Identifier: GPL-2.0

menu "Host processor type and features (s390)"
endmenu

config UML_S390
	def_bool y
	select UML_SUBARCH_MEMCPY
	select CLONE_BACKWARDS2
	select ARCH_WANT_IPC_PARSE_VERSION
	help
	  s390 passes clone(2) with the first two arguments swapped
	  (stack first, then flags — arch/Kconfig "ABI hall of shame").
	  The arm64 port needed plain CLONE_BACKWARDS (tls in 4th arg);
	  getting this wrong silently decodes the wrong stack/flags and
	  breaks threading. [DESIGN §8.5, P4: right first try]

config GENERIC_HWEIGHT
	def_bool y

config 64BIT
	def_bool y

config CPU_BIG_ENDIAN
	def_bool y
```

## arch/um/configs/s390_defconfig
```kconfig
# CONFIG_COMPACTION is not set
CONFIG_BINFMT_MISC=m
CONFIG_HOSTFS=y
CONFIG_MAGIC_SYSRQ=y
CONFIG_SYSVIPC=y
CONFIG_POSIX_MQUEUE=y
CONFIG_NO_HZ=y
CONFIG_HIGH_RES_TIMERS=y
CONFIG_BSD_PROCESS_ACCT=y
CONFIG_IKCONFIG=y
CONFIG_IKCONFIG_PROC=y
CONFIG_LOG_BUF_SHIFT=14
CONFIG_CGROUPS=y
CONFIG_CGROUP_FREEZER=y
CONFIG_CGROUP_DEVICE=y
CONFIG_CPUSETS=y
CONFIG_CGROUP_CPUACCT=y
CONFIG_CGROUP_SCHED=y
CONFIG_BLK_CGROUP=y
# CONFIG_PID_NS is not set
CONFIG_SYSFS_DEPRECATED=y
CONFIG_CC_OPTIMIZE_FOR_SIZE=y
CONFIG_MODULES=y
CONFIG_MODULE_UNLOAD=y
# CONFIG_BLK_DEV_BSG is not set
CONFIG_IOSCHED_BFQ=m
CONFIG_SSL=y
CONFIG_NULL_CHAN=y
CONFIG_PORT_CHAN=y
CONFIG_PTY_CHAN=y
CONFIG_FD_CHAN=y
CONFIG_XTERM_CHAN=y
CONFIG_CON_ZERO_CHAN="fd:0,fd:1"
CONFIG_CON_CHAN="xterm"
CONFIG_SSL_CHAN="pty"
CONFIG_UNIX98_PTYS=y
CONFIG_LEGACY_PTYS=y
CONFIG_LEGACY_PTY_COUNT=256
CONFIG_WATCHDOG=y
CONFIG_WATCHDOG_NOWAYOUT=y
CONFIG_SOFT_WATCHDOG=m
CONFIG_UML_SOUND=m
CONFIG_HOSTAUDIO=m
CONFIG_UML_NET=y
CONFIG_UML_NET_ETHERTAP=y
CONFIG_UML_NET_TUNTAP=y
CONFIG_UML_NET_SLIP=y
CONFIG_UML_NET_DAEMON=y
CONFIG_UML_NET_VECTOR=y
CONFIG_UML_NET_VDE=y
CONFIG_UML_NET_MCAST=y
CONFIG_UML_NET_SLIRP=y
CONFIG_EXT4_FS=y
CONFIG_EXT4_USE_FOR_EXT2=y
CONFIG_VFAT_FS=m
CONFIG_MS_DOS_FS=m
CONFIG_NLS_CODEPAGE_437=m
CONFIG_NLS_ISO8859_1=m
CONFIG_PROC_CHILDREN=y
CONFIG_DEVTMPFS_MOUNT=y
CONFIG_FW_LOADER_USER_HELPER=y
```

## arch/x86/um/Kconfig
```kconfig
# SPDX-License-Identifier: GPL-2.0

menu "Host processor type and features"

source "arch/x86/Kconfig.cpu"

endmenu

config UML_X86
	def_bool y
	select ARCH_USE_QUEUED_RWLOCKS
	select ARCH_SUPPORTS_ATOMIC_RMW
	select ARCH_USE_QUEUED_SPINLOCKS
	select DCACHE_WORD_ACCESS
	select HAVE_EFFICIENT_UNALIGNED_ACCESS
	select HAVE_EBPF_JIT if 64BIT
	select ARCH_WANT_DEFAULT_BPF_JIT if 64BIT
	select HAVE_CMPXCHG_DOUBLE if 64BIT
	select HAVE_ALIGNED_STRUCT_PAGE if 64BIT
	select UML_SUBARCH_SUPPORTS_SMP if X86_CX8

# UML/x86 reuses arch/x86/kernel/uprobes.c via subarch-y; the guest-user
# int3/single-step relay arrives as SIGTRAP through the skas trap path.
config ARCH_SUPPORTS_UPROBES
	def_bool y
	depends on UML_X86 && 64BIT

config 64BIT
	bool "64-bit kernel" if "$(SUBARCH)" = "x86"
	default "$(SUBARCH)" != "i386"

config X86_32
	def_bool !64BIT
	select ARCH_32BIT_OFF_T
	select ARCH_WANT_IPC_PARSE_VERSION
	select MODULES_USE_ELF_REL
	select CLONE_BACKWARDS
	select OLD_SIGSUSPEND3
	select OLD_SIGACTION

config X86_64
	def_bool 64BIT
	select MODULES_USE_ELF_RELA

config ARCH_HAS_SC_SIGNALS
	def_bool !64BIT

config GENERIC_HWEIGHT
	def_bool y
```
